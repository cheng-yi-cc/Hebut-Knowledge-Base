/*
 * AT89C52 + LGM12641BS1R / KS0108 128x64 GLCD
 * Generated from E:/Program Files/.../þG P/128_64 frames.
 * Separate material version, does not overwrite earlier animation sources.
 */

typedef unsigned char u8;
typedef unsigned int u16;

__sfr __at(0x80) P0;
__sfr __at(0xA0) P2;

__sbit __at(0xA0) LCD_DI;
__sbit __at(0xA1) LCD_RW;
__sbit __at(0xA2) LCD_E;
__sbit __at(0xA3) LCD_CS1;
__sbit __at(0xA4) LCD_CS2;
__sbit __at(0xA5) LCD_RST;

#define PATCH_COUNT 61
#define FRAME_DELAY_MS 0

static const u16 __code PATCH_OFFSETS[PATCH_COUNT + 1] = {
    0,326,380,459,728,1032,1258,1530,1770,2009,2021,2025,
    2261,2528,2754,2977,3178,3384,3448,3509,3769,4008,4016,4024,
    4258,4471,4695,4891,5170,5444,5702,5973,6226,6485,6501,6513,
    6566,6651,6945,7248,7491,7750,8015,8292,8292,8296,8539,8791,
    8991,9214,9274,9333,9605,9865,10117,10335,10339,10355,10566,10783,
    11098,11418
};

static const u8 __code PATCH_DATA[11418] = {
    0x00,0x2F,0x0B,0x80,0xC0,0xF0,0x78,0x38,0x18,0x1C,0x38,0xF0,0xE0,0x80,0x00,0x4A,
    0x0A,0x80,0x80,0xC0,0xC0,0xC0,0xE0,0xE0,0xE0,0xC0,0x80,0x01,0x28,0x09,0x80,0xC0,
    0xE0,0xF0,0x70,0x3C,0x1F,0x0F,0x03,0x01,0x37,0x09,0x03,0x03,0x03,0x03,0x03,0x03,
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    0x61,0x67,0x07,0x52,0x05,0x0E,0x0C,0x0C,0x1C,0x1C
};

static void tiny_delay(void)
{
    __asm
        nop
        nop
    __endasm;
}

static void delay_ms(u16 ms)
{
    u16 i;
    while (ms--) {
        for (i = 0; i < 112; i++) tiny_delay();
    }
}

static void glcd_pulse(void)
{
    LCD_E = 1;
    tiny_delay();
    LCD_E = 0;
    tiny_delay();
}

static void glcd_select(u8 half)
{
    LCD_CS1 = (half == 0);
    LCD_CS2 = (half != 0);
}

static void glcd_write(u8 half, u8 is_data, u8 value)
{
    glcd_select(half);
    LCD_DI = is_data;
    LCD_RW = 0;
    P0 = value;
    tiny_delay();
    glcd_pulse();
}

static void glcd_cmd(u8 half, u8 cmd) { glcd_write(half, 0, cmd); }
static void glcd_data(u8 half, u8 value) { glcd_write(half, 1, value); }

static void glcd_set_pos(u8 x, u8 page)
{
    u8 half = (x >= 64);
    glcd_cmd(half, 0xB8 | (page & 0x07));
    glcd_cmd(half, 0x40 | (x & 0x3F));
}

static void glcd_init(void)
{
    P0 = 0x00;
    LCD_E = 0;
    LCD_RW = 0;
    LCD_CS1 = 1;
    LCD_CS2 = 1;
    LCD_RST = 0;
    delay_ms(20);
    LCD_RST = 1;
    delay_ms(20);
    glcd_cmd(0, 0x3F);
    glcd_cmd(1, 0x3F);
    glcd_cmd(0, 0xC0);
    glcd_cmd(1, 0xC0);
}

static void clear_screen(void)
{
    u8 page, half, x;
    for (page = 0; page < 8; page++) {
        for (half = 0; half < 2; half++) {
            glcd_set_pos(half ? 64 : 0, page);
            for (x = 0; x < 64; x++) glcd_data(half, 0);
        }
    }
}

static void write_patch(u8 patch)
{
    u16 i = PATCH_OFFSETS[patch];
    u16 end = PATCH_OFFSETS[patch + 1];
    u8 page, x, count, half;
    while (i < end) {
        page = PATCH_DATA[i++];
        x = PATCH_DATA[i++];
        count = PATCH_DATA[i++];
        half = (x >= 64);
        glcd_set_pos(x, page);
        while (count--) glcd_data(half, PATCH_DATA[i++]);
    }
}

void main(void)
{
    u8 patch = 0;
    glcd_init();
    clear_screen();
    while (1) {
        write_patch(patch);
        patch++;
        if (patch >= PATCH_COUNT) patch = 0;
#if FRAME_DELAY_MS > 0
        delay_ms(FRAME_DELAY_MS);
#endif
    }
}
